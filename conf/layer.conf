## conf/layer.conf
```bitbake
# We might have a conf and classes directory, append to BBPATH
BBPATH .= ":${LAYERDIR}"

# We have a recipes directory, add to BBFILES
BBFILES += "${LAYERDIR}/recipes*/*/*.bb ${LAYERDIR}/recipes*/*/*.bbappend"

BBFILE_COLLECTIONS += "meta-torizon-bsp"
BBFILE_PATTERN_meta-torizon-bsp := "^${LAYERDIR}/"
BBFILE_PRIORITY_meta-torizon-bsp = "91"

LAYERDEPENDS_meta-torizon-bsp = "meta-torizon"
LAYERSERIES_COMPAT_meta-torizon-bsp = "wrynose"

BBFILES_DYNAMIC += "\
    freescale-layer:${LAYERDIR}/dynamic-layers/meta-freescale/*/*/*.bb \
    freescale-layer:${LAYERDIR}/dynamic-layers/meta-freescale/*/*/*.bbappend \
    fsl-bsp-release:${LAYERDIR}/dynamic-layers/meta-imx-bsp/*/*/*.bb \
    fsl-bsp-release:${LAYERDIR}/dynamic-layers/meta-imx-bsp/*/*/*.bbappend \
    imx-frdm-release:${LAYERDIR}/dynamic-layers/meta-imx-frdm/*/*/*.bbappend \
    imx-machine-learning:${LAYERDIR}/dynamic-layers/meta-imx-ml/*/*/*.bb \
    imx-machine-learning:${LAYERDIR}/dynamic-layers/meta-imx-ml/*/*/*.bbappend \
    intel:${LAYERDIR}/dynamic-layers/meta-intel/*/*/*.bb \
    intel:${LAYERDIR}/dynamic-layers/meta-intel/*/*/*.bbappend \
    meta-beagle:${LAYERDIR}/dynamic-layers/meta-beagle/*/*/*.bb \
    meta-beagle:${LAYERDIR}/dynamic-layers/meta-beagle/*/*/*.bbappend \
    meta-rz-bsp:${LAYERDIR}/dynamic-layers/meta-rz-bsp/*/*/*.bb \
    meta-rz-bsp:${LAYERDIR}/dynamic-layers/meta-rz-bsp/*/*/*.bbappend \
    meta-synaptics:${LAYERDIR}/dynamic-layers/meta-synaptics/*/*/*.bb \
    meta-synaptics:${LAYERDIR}/dynamic-layers/meta-synaptics/*/*/*.bbappend \
    meta-ti-bsp:${LAYERDIR}/dynamic-layers/meta-ti-bsp/*/*/*.bb \
    meta-ti-bsp:${LAYERDIR}/dynamic-layers/meta-ti-bsp/*/*/*.bbappend \
    toradex-bsp-common-layer:${LAYERDIR}/dynamic-layers/meta-toradex-bsp/meta-toradex-bsp-common/*/*/*.bb \
    toradex-bsp-common-layer:${LAYERDIR}/dynamic-layers/meta-toradex-bsp/meta-toradex-bsp-common/*/*/*.bbappend \
    toradex-ti-layer:${LAYERDIR}/dynamic-layers/meta-toradex-bsp/meta-toradex-ti/*/*/*.bb \
    toradex-ti-layer:${LAYERDIR}/dynamic-layers/meta-toradex-bsp/meta-toradex-ti/*/*/*.bbappend \
    stm-st-stm32mp:${LAYERDIR}/dynamic-layers/meta-stm32mp-bsp/*/*/*.bb \
    stm-st-stm32mp:${LAYERDIR}/dynamic-layers/meta-stm32mp-bsp/*/*/*.bbappend \
    tegra:${LAYERDIR}/dynamic-layers/meta-tegra/*/*/*.bb \
    tegra:${LAYERDIR}/dynamic-layers/meta-tegra/*/*/*.bbappend \
    toradex-bsp-common-layer:${LAYERDIR}/dynamic-layers/meta-toradex-bsp-common/*/*/*.bb \
    toradex-bsp-common-layer:${LAYERDIR}/dynamic-layers/meta-toradex-bsp-common/*/*/*.bbappend \
    toradex-ti-layer:${LAYERDIR}/dynamic-layers/meta-toradex-ti/*/*/*.bb \
    toradex-ti-layer:${LAYERDIR}/dynamic-layers/meta-toradex-ti/*/*/*.bbappend \
    virtualization-layer:${LAYERDIR}/dynamic-layers/meta-virtualization/*/*/*.bb \
    virtualization-layer:${LAYERDIR}/dynamic-layers/meta-virtualization/*/*/*.bbappend \
    mediatek-bsp:${LAYERDIR}/dynamic-layers/meta-mediatek-bsp/*/*/*.bb \
    mediatek-bsp:${LAYERDIR}/dynamic-layers/meta-mediatek-bsp/*/*/*.bbappend \
    adlinktech-bsp:${LAYERDIR}/dynamic-layers/meta-adlink-mtk/*/*/*.bb \
    adlinktech-bsp:${LAYERDIR}/dynamic-layers/meta-adlink-mtk/*/*/*.bbappend \
"
```

## conf/machine/include/jetson-orin-nano-devkit.inc
```bitbake
require tegra-torizon.inc

IMAGE_INSTALL:append:tegra = " nvidia-container-toolkit nvidia-drm-loadconf"

IMAGE_INSTALL:remove:pn-torizon-minimal = " nvidia-container-toolkit"
```

## conf/machine/include/tegra-torizon.inc
```bitbake
TEGRA_ESSENTIAL_EXTRA_RDEPENDS:remove = " \
  l4t-launcher-extlinux \
"

OSTREE_KERNEL_ARGS:append = " ${KERNEL_ARGS} root=/dev/${TNSPEC_BOOTDEV} rootfstype=ext4 rootwait"

IMAGE_TEGRAFLASH_KERNEL = "${DEPLOY_DIR_IMAGE}/tegra-minimal-initramfs-${MACHINE}.cboot"
IMAGE_TEGRAFLASH_FS_TYPE:tegra = "ota-ext4"
IMAGE_ROOTFS_SIZE = "${@'4194304' if d.getVar('RESIZE_HELPER') else tegra_default_rootfs_size(d)}"

BBMASK += "meta-tegra/external/sota/recipes-bsp/uefi/edk2-firmware-tegra_%.bbappend"

do_image_tegraflash_tar[depends] += " tegra-minimal-initramfs:do_image_complete \
                                     nvidia2img-tools:do_deploy"

MACHINE_EXTRA_RDEPENDS:remove = " tegra-redundant-boot"

# meta-tegra uses A/B layout, we don't want it here.
HAS_REDUNDANT_PARTITION_LAYOUT_EXTERNAL = "0"

PREFERRED_PROVIDER_u-boot-fw-utils = "u-boot-fw-utils-tegra-emul"
PREFERRED_RPROVIDER_u-boot-fw-utils = "u-boot-fw-utils-tegra-emul"

# Dedicated override function from image_types_tegra.bbclass
# Add conversion scripts for tegraflash format
tegraflash_custom_pre:append() {
    for script in tegra2img img2tegra; do
        cp ${DEPLOY_DIR_IMAGE}/nvidia2img-tools/${script}.pyz .
    done
}
```
